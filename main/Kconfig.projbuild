## sdkconfig.defaults
```kconfig
CONFIG_IDF_TARGET="esp32p4"
CONFIG_ESPTOOLPY_FLASHMODE_QIO=y
CONFIG_ESPTOOLPY_FLASHSIZE_16MB=y
CONFIG_COMPILER_OPTIMIZATION_PERF=y
CONFIG_SPIRAM=y
CONFIG_SPIRAM_SPEED_200M=y
CONFIG_SPIRAM_XIP_FROM_PSRAM=y
CONFIG_CACHE_L2_CACHE_256KB=y
CONFIG_CACHE_L2_CACHE_LINE_128B=y
CONFIG_ESP_MAIN_TASK_STACK_SIZE=10240
CONFIG_FREERTOS_HZ=1000
CONFIG_FREERTOS_VTASKLIST_INCLUDE_COREID=y
CONFIG_FREERTOS_GENERATE_RUN_TIME_STATS=y

CONFIG_PARTITION_TABLE_CUSTOM=y
CONFIG_PARTITION_TABLE_CUSTOM_FILENAME="partitions.csv"
CONFIG_PARTITION_TABLE_FILENAME="partitions.csv"
CONFIG_PARTITION_TABLE_OFFSET=0x8000

# Camera OV5647 Settings
CONFIG_CAMERA_OV5647=y
CONFIG_CAMERA_OV5647_AUTO_DETECT_MIPI_INTERFACE_SENSOR=y
CONFIG_CAMERA_OV5647_MIPI_RAW8_800X640_50FPS=y
CONFIG_CAMERA_OV5647_MIPI_DEFAULT_FMT_RAW8_800X640_50FPS=y
CONFIG_CAMERA_OV5647_MIPI_IF_FORMAT_INDEX_DEFAULT=1
CONFIG_EXAMPLE_ENABLE_MIPI_CSI_CAM_SENSOR=y
CONFIG_ESP_VIDEO_ENABLE_SWAP_BYTE=y
CONFIG_EXAMPLE_SCCB_I2C_INIT_BY_APP=y
CONFIG_ESP_VIDEO_ENABLE_ISP_PIPELINE_CONTROLLER=y

# Video pipeline hardware devices
CONFIG_ESP_VIDEO_ENABLE_HW_H264_VIDEO_DEVICE=y
CONFIG_ESP_VIDEO_ENABLE_HW_JPEG_VIDEO_DEVICE=y

# UVC Example configurations
CONFIG_FORMAT_MJPEG_CAM1=y
CONFIG_FRAMESIZE_SVGA=y
# CONFIG_FRAMESIZE_HD is not set
CONFIG_UVC_CAM1_FRAMESIZE_WIDTH=800
CONFIG_UVC_CAM1_FRAMESIZE_HEIGT=640
# CONFIG_UVC_CAM1_MULTI_FRAMESIZE is not set
CONFIG_UVC_CAM1_FRAMERATE=30
CONFIG_IDF_EXPERIMENTAL_FEATURES=y
CONFIG_EXAMPLE_DISABLE_USB_MSC_STORAGE=y

# Configure TinyUSB to run in Full-Speed mode (required for GPIO24/25 routing)
CONFIG_TINYUSB_RHPORT_FS=y
# CONFIG_TINYUSB_RHPORT_HS is not set

# Increase VFS max count for esp_video device registration
CONFIG_VFS_MAX_COUNT=20
```
